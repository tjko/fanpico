/* i2c_sht4x.c
   Copyright (C) 2024 Timo Kokkonen <tjko@iki.fi>

   SPDX-License-Identifier: GPL-3.0-or-later

   This file is part of FanPico.

   FanPico is free software: you can redistribute it and/or modify
   it under the terms of the GNU General Public License as published by
   the Free Software Foundation, either version 3 of the License, or
   (at your option) any later version.

   FanPico is distributed in the hope that it will be useful,
   but WITHOUT ANY WARRANTY; without even the implied warranty of
   MERCHANTABILITY or FITNESS FOR A PARTICULAR PURPOSE. See the
   GNU General Public License for more details.

   You should have received a copy of the GNU General Public License
   along with FanPico. If not, see <https://www.gnu.org/licenses/>.
*/

#include <stdio.h>
#include <string.h>
#include <stdlib.h>
#include "pico/stdlib.h"
#include "hardware/gpio.h"
#include "hardware/i2c.h"

#include "i2c.h"

/* SHT4X Commands */
#define CMD_MEASURE_HP         0xfd
#define CMD_MEASURE_MP         0xf6
#define CMD_MEASURE_LR         0xe0
#define CMD_READ_SERIAL        0x89
#define CMD_SOFT_RESET         0x94

typedef struct sht4x_context_t {
	i2c_inst_t *i2c;
	uint8_t addr;
} sht4x_context_t;


/* CRC-8 Lookup Table (Polymonial 0x31) */
static const uint8_t sht4x_crc_lookup_table[] = {
	0x00,0x31,0x62,0x53,0xC4,0xF5,0xA6,0x97,0xB9,0x88,0xDB,0xEA,0x7D,0x4C,0x1F,0x2E,
	0x43,0x72,0x21,0x10,0x87,0xB6,0xE5,0xD4,0xFA,0xCB,0x98,0xA9,0x3E,0x0F,0x5C,0x6D,
	0x86,0xB7,0xE4,0xD5,0x42,0x73,0x20,0x11,0x3F,0x0E,0x5D,0x6C,0xFB,0xCA,0x99,0xA8,
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	0x82,0xB3,0xE0,0xD1,0x46,0x77,0x24,0x15,0x3B,0x0A,0x59,0x68,0xFF,0xCE,0x9D,0xAC
};

static uint8_t crc8(uint8_t *buf, size_t len)
{
	uint8_t crc = 0xff;

	for (int i = 0; i < len; i++) {
		crc = sht4x_crc_lookup_table[crc ^ buf[i]];
	}

	return crc;
}


void* sht4x_init(i2c_inst_t *i2c, uint8_t addr)
{
	sht4x_context_t *ctx = calloc(1, sizeof(sht4x_context_t));
	uint8_t buf[6];
	int res;

	if (!ctx)
		return NULL;
	ctx->i2c = i2c;
	ctx->addr = addr;

	memset(buf, 0, sizeof(buf));

	/* Read and verify device serial */
	res = i2c_read_register_block(i2c, addr, CMD_READ_SERIAL, buf, sizeof(buf), 1000);
	if (res)
		goto panic;

	/* Check CRC of received values */
	if ((crc8(&buf[0], 2) != buf[2]) || (crc8(&buf[3], 2) != buf[5])) {
		DEBUG_PRINT("invalid serial (CRC mismatch)\n");
		goto panic;
	}
#if I2C_DEBUG > 0
	uint32_t serial = (buf[0] << 24 | buf[1] << 16 | buf[3] << 8 | buf[4]);
	DEBUG_PRINT("sensor serial: %08lx\n", serial);
#endif

	/* Reset sensor */
	res = i2c_write_raw_u8(i2c, addr, CMD_SOFT_RESET, false);
	if (res)
		goto panic;
	sleep_us(1000);


	/* Read and verify device serial again */
	res = i2c_read_register_block(i2c, addr, CMD_READ_SERIAL, buf, sizeof(buf), 1000);
	if (res)
		goto panic;

	/* Check CRC of received values */
	if ((crc8(&buf[0], 2) != buf[2]) || (crc8(&buf[3], 2) != buf[5])) {
		DEBUG_PRINT("invalid serial (CRC mismatch)\n");
		goto panic;
	}

	return ctx;

panic:
	free(ctx);
	return NULL;
}


int sht4x_start_measurement(void *ctx)
{
	sht4x_context_t *c = (sht4x_context_t*)ctx;
	int res;

	/* Initiate measurement */
	res = i2c_write_raw_u8(c->i2c, c->addr, CMD_MEASURE_HP, false);
	if (res)
		return -1;

	return 9;  /* measurement should be available after 8.3ms */
}


int sht4x_get_measurement(void *ctx, float *temp, float *pressure, float *humidity)
{
	sht4x_context_t *c = (sht4x_context_t*)ctx;
	int res;
	uint8_t buf[6];
	uint16_t t_raw = 0;
	uint16_t h_raw = 0;

	/* Get Measurement */
	res = i2c_read_raw(c->i2c, c->addr, buf, 6, false);
	if (res)
		return -1;

	/* Check CRC of received values */
	if (crc8(&buf[0], 2) != buf[2])
		return -2;
	if (crc8(&buf[3], 2) != buf[5])
		return -3;

	t_raw = (buf[0] << 8) | buf[1];
	h_raw = (buf[3] << 8) | buf[4];
	DEBUG_PRINT("h_raw = %u, t_raw = %u\n", h_raw, t_raw);

	*temp = -45 + 175 * (double) t_raw / 65535;
	*pressure = -1.0;
	*humidity = -6 + 125 * (double) h_raw / 65535;
	if (*humidity > 100.0)
		*humidity = 100.0;
	if (*humidity < 0.0)
		*humidity = 0.0;

	DEBUG_PRINT("temp: %0.1f, humidity: %0.1f\n", *temp, *humidity);

	return 0;
}


